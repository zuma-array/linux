## Documentation/devicetree/bindings/mtd/gpmi-nand.txt
```
* Freescale General-Purpose Media Interface (GPMI)

The GPMI nand controller provides an interface to control the
NAND flash chips.

Required properties:
  - compatible : should be "fsl,<chip>-gpmi-nand", chip can be:
    * imx23
    * imx28
    * imx6q
    * imx6qp
    * imx6sx
    * imx6ul
    * imx7d
    * imx6ull
  - reg : should contain registers location and length for gpmi and bch.
  - reg-names: Should contain the reg names "gpmi-nand" and "bch"
  - interrupts : BCH interrupt number.
  - interrupt-names : Should be "bch".
  - dmas: DMA specifier, consisting of a phandle to DMA controller node
    and GPMI DMA channel ID.
    Refer to dma.txt and fsl-mxs-dma.txt for details.
  - dma-names: Must be "rx-tx".
  - clocks : clocks phandle and clock specifier corresponding to each clock
    specified in clock-names.
  - clock-names : The "gpmi_io" clock is always required. Which clocks are
    exactly required depends on chip:
    * imx23/imx28 : "gpmi_io"
    * imx6q/sx : "gpmi_io", "gpmi_apb", "gpmi_bch", "gpmi_bch_apb", "per1_bch"
    * imx7d : "gpmi_io", "gpmi_bch_apb"

Optional properties:
  - nand-on-flash-bbt: boolean to enable on flash bbt option if not
                       present false
  - fsl,use-minimum-ecc: Protect this NAND flash with the minimum ECC
                       strength required. The required ECC strength is
                       automatically discoverable for some flash
                       (e.g., according to the ONFI standard).
                       However, note that if this strength is not
                       discoverable or this property is not enabled,
                       the software may chooses an implementation-defined
                       ECC scheme.
  - fsl,no-blockmark-swap: Don't swap the bad block marker from the OOB
                       area with the byte in the data area but rely on the
                       flash based BBT for identifying bad blocks.
                       NOTE: this is only valid in conjunction with
                             'nand-on-flash-bbt'.
                       WARNING: on i.MX28 blockmark swapping cannot be
                       disabled for the BootROM in the FCB. Thus,
                       partitions written from Linux with this feature
                       turned on may not be accessible by the BootROM
                       code.
 - fsl,legacy-bch-geometry: Use legacy bch geometry(ECC scheme) that
                       compatible with 3.10 kernel. Without the property,
                       software may use ECC strength according to NAND chip
                       spec, e.g. ONFI standard.

 - timings: node containing the desired timing parameters for the NAND chip,
	if this node is not present or some required timing is missing, the driver
	will fallback to safe defaults.

	NOTE: Either sample-delay-ns needs to be specified or all 3 t*-ns timings.

	Child properties:
	  - data-setup-ns: The data setup time, in nanoseconds. Usually the
	  		maximum of tDS and tWP.
	  - data-hold-ns: The data hold time, in nanoseconds. Usually the
	  		maximum of tDH, tWH and tREH.
	  - address-setup-ns: The address setup time, in nanoseconds. Usually
	  		the maximum of tCLS, tCS and tALS.

	  either
	  - sample-delay-ns: A GPMI-specific timing parameter.
	  or
	  - trea-ns: tREA, in nanoseconds, from the data sheet.
	  - trloh-ns: tRLOH, in nanoseconds, from the data sheet.
	  - trhoh-ns: tRHOH, in nanoseconds, from the data sheet.

The device tree may optionally contain sub-nodes describing partitions of the
address space. See partition.txt for more detail.

Examples:

gpmi-nand@8000c000 {
	compatible = "fsl,imx28-gpmi-nand";
	#address-cells = <1>;
	#size-cells = <1>;
	reg = <0x8000c000 2000>, <0x8000a000 2000>;
	reg-names = "gpmi-nand", "bch";
	interrupts = <41>;
	interrupt-names = "bch";
	dmas = <&dma_apbh 4>;
	dma-names = "rx-tx";

	timings {
		data-setup-ns = <12>;
		data-hold-ns = <11>;
		address-setup-ns = <20>;
		trea-ns = <5>;
		trloh-ns = <5>;
		trhoh-ns = <25>;
	};

	partition@0 {
	...
	};
};

gpmi-nand@8000c000 {
	...
	timings {
		data-setup-ns = <80>;
		data-hold-ns = <60>;
		address-setup-ns = <25>;
		sample-delay-ns = <6>;
	};
	...
};
```

## Documentation/devicetree/bindings/sound/ess-es9018.txt
```
ESS ES9018K2M DAC Driver

Required properties:

 - compatible:		Should contain "ess,es9018k2m".
 - reg:			The i2c address.

Optional properties:

 - reset-gpio: 		A GPIO spec to define which pin is connected to the
			chip's !RESET pin. If specified, the driver will
			assert a hardware reset at probe time.

Examples:

	i2c_bus {
		es9018@90 {
			compatible = "ess,es9018k2m";
			reg = <0x90>;
			reset-gpio = <&gpio1 15 0>;
		};
	};
```
