/*
 * This program is free software; you can redistribute it and/or modify
 * it under the terms of the GNU General Public License version 2 as
 * published by the Free Software Foundation.
 */

 #include "imx7d-sue-s810-common-0.dtsi"

&i2c1 {
	clock-frequency = <100000>;
	pinctrl-names = "default";
	pinctrl-0 = <&pinctrl_i2c1>;
	status = "okay";
};

&iomuxc {
	imx7d-sue-s810-basic {
		pinctrl_i2c1: i2c1grp {
			fsl,pins = <
				MX7D_PAD_I2C1_SCL__I2C1_SCL		0x4000007f
				MX7D_PAD_I2C1_SDA__I2C1_SDA		0x4000007f
			>;
		};
	};
};

