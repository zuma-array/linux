/*
 * arch/arm64/boot/dts/amlogic/axg_sue_l2_streamkit1832_4LCD_43480272.dtsi
 *
 * Copyright (C) 2020 StreamUnlimited, Inc. All rights reserved.
 *
 * This program is free software; you can redistribute it and/or modify
 * it under the terms of the GNU General Public License as published by
 * the Free Software Foundation; either version 2 of the License, or
 * (at your option) any later version.
 *
 * This program is distributed in the hope that it will be useful, but WITHOUT
 * ANY WARRANTY; without even the implied warranty of MERCHANTABILITY or
 * FITNESS FOR A PARTICULAR PURPOSE.  See the GNU General Public License for
 * more details.
 *
 */


/*
 * DT for the 4LCD_43480272 display using the lt7381 SPI bridge chip and its
 * components located on the daughter board. This is an alternative 4.3in 16:9
 * display which does not fit in the StreamKit1832 case.
 */

&stream183x_display {
	width = <480>;
	height = <272>;
	pwm-count = <1800>;
	backlight-max-brightness = <90>;
	backlight-default-brightness = <75>;

	display-timings {

		FOUR_LCD_43480272: FOUR_LCD_43480272 {
			clock-frequency = <14000000>;
			hactive = <480>;
			vactive = <272>;
			hback-porch = <20>;
			hsync-len = <20>;
			hfront-porch = <20>;
			vback-porch = <2>;
			vsync-len = <10>;
			vfront-porch = <40>;
			hsync-active = <10>;
			vsync-active = <30>;
			de-active = <0>;
			pixelclk-active = <1>;
		};
	};
};
